#include "rcauto_cpp/core.hpp"
#include <ackermann_msgs/msg/ackermann_drive_stamped.hpp>
#include <rclcpp/rclcpp.hpp>
#include <std_msgs/msg/string.hpp>
#include <std_msgs/msg/float32.hpp>
#include <linux/i2c-dev.h>
#include <sys/ioctl.h>
#include <fcntl.h>
#include <unistd.h>
#include <algorithm>
#include <chrono>
#include <thread>
#include <utility>
#include <cmath>
#include <cstdint>
#include <memory>
#include <stdexcept>
#include <string>
using namespace std::chrono_literals;
namespace {
using Steady=std::chrono::steady_clock;
// External PCA9685 uses Pi header SDA GPIO2 (pin 3), SCL GPIO3 (pin 5).
// PWM is generated by the external chip, independent of non-real-time Linux scheduling.
class Pca9685 {
 public:
  Pca9685(std::string device,int addr):device_(std::move(device)),address_(addr) {}
  ~Pca9685(){if(fd_>=0)::close(fd_);}
  Pca9685(const Pca9685&)=delete;Pca9685&operator=(const Pca9685&)=delete;
  void open_device() {
    fd_=::open(device_.c_str(),O_RDWR|O_CLOEXEC);
    if(fd_<0||::ioctl(fd_,I2C_SLAVE,address_)<0)
      throw std::runtime_error("PCA9685 I2C open or slave address failed");
    write_reg(0x00,0x10);
    write_reg(0xFE,121);  // approx 50 Hz at 25 MHz oscillator
    write_reg(0x00,0x20); // MODE1 auto increment, wake
    std::this_thread::sleep_for(5ms);
  }
  void channel_pulse(int channel,int microseconds) {
    if(channel<0||channel>15||microseconds<900||microseconds>2100)
      throw std::invalid_argument("PCA pulse outside verified bounds");
    const int count=std::clamp(static_cast<int>(std::lround(microseconds*4096.0/20000.0)),1,4095);
    const uint8_t reg=static_cast<uint8_t>(0x06+4*channel);
    const uint8_t payload[]={reg,0,0,static_cast<uint8_t>(count&255),
                             static_cast<uint8_t>((count>>8)&0x0F)};
    if(::write(fd_,payload,sizeof(payload))!=static_cast<ssize_t>(sizeof(payload)))
      throw std::runtime_error("PCA9685 I2C write failed");
  }
 private:
  void write_reg(uint8_t reg,uint8_t value){
    const uint8_t data[]={reg,value};
    if(::write(fd_,data,2)!=2)throw std::runtime_error("PCA9685 configuration failed");
  }
  std::string device_;int address_,fd_{-1};
};
}
class Actuator final:public rclcpp::Node{
 public:
  Actuator():Node("rcauto_cpp_actuator") {
    declare_parameter("actuator.hardware_enabled",false);
    declare_parameter("actuator.live_ack","");
    declare_parameter("actuator.backend","pca9685");
    declare_parameter("actuator.i2c_device","/dev/i2c-1");
    declare_parameter("actuator.i2c_address",64);
    declare_parameter("actuator.steering_channel",0);
    declare_parameter("actuator.esc_channel",1);
    declare_parameter("actuator.servo_center_us",1500);
    declare_parameter("actuator.servo_min_us",1100);
    declare_parameter("actuator.servo_max_us",1900);
    declare_parameter("actuator.esc_neutral_us",1500);
    declare_parameter("actuator.esc_forward_us",1600);
    declare_parameter("actuator.max_steering_rad",0.35);
    declare_parameter("actuator.max_speed_mps",0.18);
    declare_parameter("actuator.watchdog_s",0.25);
    declare_parameter("actuator.max_servo_step_us",40);
    hardware_=get_parameter("actuator.hardware_enabled").as_bool();
    center_=static_cast<int>(get_parameter("actuator.servo_center_us").as_int());
    servo_min_=static_cast<int>(get_parameter("actuator.servo_min_us").as_int());
    servo_max_=static_cast<int>(get_parameter("actuator.servo_max_us").as_int());
    esc_neutral_=static_cast<int>(get_parameter("actuator.esc_neutral_us").as_int());
    esc_forward_=static_cast<int>(get_parameter("actuator.esc_forward_us").as_int());
    max_steer_=get_parameter("actuator.max_steering_rad").as_double();
    max_speed_=get_parameter("actuator.max_speed_mps").as_double();
    watchdog_=get_parameter("actuator.watchdog_s").as_double();
    max_step_=static_cast<int>(get_parameter("actuator.max_servo_step_us").as_int());
    const int servo_ch=static_cast<int>(get_parameter("actuator.steering_channel").as_int());
    const int esc_ch=static_cast<int>(get_parameter("actuator.esc_channel").as_int());
    if(servo_ch==esc_ch||servo_ch<0||servo_ch>15||esc_ch<0||esc_ch>15||
       !(900<=servo_min_&&servo_min_<center_&&center_<servo_max_&&servo_max_<=2100)||
       !(1000<=esc_neutral_&&esc_neutral_<esc_forward_&&esc_forward_<=1900)||
       max_speed_<=0||max_steer_<=0||watchdog_<.05||watchdog_>.5||max_step_<=0)
       throw std::invalid_argument("Invalid actuator calibration");
    servo_ch_=servo_ch;esc_ch_=esc_ch;last_servo_=center_;
    if(hardware_) {
      if(get_parameter("actuator.live_ack").as_string()!="CONFIRM_WHEELS_UP_EXTERNAL_ESTOP")
        throw std::runtime_error("Live actuator requires explicit physical E-stop acknowledgement");
      if(get_parameter("actuator.backend").as_string()!="pca9685")
        throw std::runtime_error("Only PCA9685 external hardware PWM is implemented");
      i2c_=std::make_unique<Pca9685>(get_parameter("actuator.i2c_device").as_string(),
                    static_cast<int>(get_parameter("actuator.i2c_address").as_int()));
      i2c_->open_device();
      i2c_->channel_pulse(servo_ch_,center_);
      i2c_->channel_pulse(esc_ch_,esc_neutral_);
      RCLCPP_WARN(get_logger(),"LIVE PCA9685 ENABLED: ensure physical E-stop exists");
    } else RCLCPP_WARN(get_logger(),"DRY-RUN. No I2C or PWM output enabled.");
    // Actuator calibration parameters are immutable at runtime, including via Foxglove.
    parameters_=add_on_set_parameters_callback(
      [](const std::vector<rclcpp::Parameter>& ps) {
        rcl_interfaces::msg::SetParametersResult response;response.successful=true;
        for(const auto& p:ps)if(p.get_name().rfind("actuator.",0)==0){
          response.successful=false;response.reason="Actuator calibration requires restart";
        }
        return response;
      });
    sub_=create_subscription<ackermann_msgs::msg::AckermannDriveStamped>(
      "/rcauto/drive",10,[this](ackermann_msgs::msg::AckermannDriveStamped::ConstSharedPtr m){
        const auto s=static_cast<double>(m->drive.speed);
        const auto angle=static_cast<double>(m->drive.steering_angle);
        if(!std::isfinite(s)||!std::isfinite(angle)){
          speed_=0;steer_=0;last_msg_=Steady::time_point{};return;
        }
        speed_=rcauto::clamp(s,0,max_speed_);
        steer_=rcauto::clamp(angle,-max_steer_,max_steer_);
        last_msg_=Steady::now();
      });
    pub_=create_publisher<std_msgs::msg::String>("/rcauto/actuator_status",10);
    steer_ms_pub_=create_publisher<std_msgs::msg::Float32>("/rcauto/actuator/steering_pwm_ms",10);
    esc_ms_pub_=create_publisher<std_msgs::msg::Float32>("/rcauto/actuator/esc_pwm_ms",10);
    steer_us_pub_=create_publisher<std_msgs::msg::Float32>("/rcauto/actuator/steering_pwm_us",10);
    esc_us_pub_=create_publisher<std_msgs::msg::Float32>("/rcauto/actuator/esc_pwm_us",10);
    steer_rad_pub_=create_publisher<std_msgs::msg::Float32>("/rcauto/actuator/steering_rad",10);
    speed_pub_=create_publisher<std_msgs::msg::Float32>("/rcauto/actuator/esc_speed_mps",10);
    steer_norm_pub_=create_publisher<std_msgs::msg::Float32>("/rcauto/actuator/steering_normalized",10);
    esc_norm_pub_=create_publisher<std_msgs::msg::Float32>("/rcauto/actuator/esc_normalized",10);
    timer_=create_wall_timer(50ms,[this]{tick();});
  }
  ~Actuator() override {
    if(i2c_)try {i2c_->channel_pulse(esc_ch_,esc_neutral_);
                    i2c_->channel_pulse(servo_ch_,center_);}
    catch(const std::exception&) {} // best effort; independent power cut required
  }
 private:
  void tick() {
    const bool fresh=last_msg_!=Steady::time_point{} &&
       std::chrono::duration<double>(Steady::now()-last_msg_).count()<watchdog_;
    const double speed=fresh?speed_:0,angle=fresh?steer_:0;
    const double span=angle>=0?servo_max_-center_:center_-servo_min_;
    const int target=static_cast<int>(std::lround(center_+angle/max_steer_*span));
    last_servo_+=std::clamp(target-last_servo_,-max_step_,max_step_);
    const int esc=static_cast<int>(std::lround(
      esc_neutral_+(speed/max_speed_)*(esc_forward_-esc_neutral_)));
    if(i2c_)try {
      i2c_->channel_pulse(servo_ch_,last_servo_);
      i2c_->channel_pulse(esc_ch_,esc);
    }catch(const std::exception& e){
      RCLCPP_FATAL(get_logger(),"I2C actuator write failed: %s",e.what());
      // Fail shut: communication failure requires external hardware power cut.
      rclcpp::shutdown();
    }
    std_msgs::msg::String status;
    status.data=std::string(hardware_?"LIVE":"DRY")+" | servo_us="+
                std::to_string(last_servo_)+" | esc_us="+std::to_string(esc)+
                " | watchdog="+(fresh?"OK":"STOP");
    pub_->publish(status);
    auto emit = [](const rclcpp::Publisher<std_msgs::msg::Float32>::SharedPtr& pub,
                   double value) {
      std_msgs::msg::Float32 message;
      message.data = static_cast<float>(value);
      pub->publish(message);
    };
    emit(steer_ms_pub_, last_servo_ / 1000.0);
    emit(esc_ms_pub_, esc / 1000.0);
    emit(steer_us_pub_, last_servo_);
    emit(esc_us_pub_, esc);
    emit(steer_rad_pub_, angle);
    emit(speed_pub_, speed);
    emit(steer_norm_pub_, angle / max_steer_);
    emit(esc_norm_pub_, speed / max_speed_);
  }
  bool hardware_{false};
  int center_{1500},servo_min_{1100},servo_max_{1900},esc_neutral_{1500},
      esc_forward_{1600},last_servo_{1500},servo_ch_{0},esc_ch_{1},max_step_{40};
  double max_steer_{.35},max_speed_{.18},watchdog_{.25},speed_{0},steer_{0};
  Steady::time_point last_msg_{};
  std::unique_ptr<Pca9685> i2c_;
  rclcpp::node_interfaces::OnSetParametersCallbackHandle::SharedPtr parameters_;
  rclcpp::Subscription<ackermann_msgs::msg::AckermannDriveStamped>::SharedPtr sub_;
  rclcpp::Publisher<std_msgs::msg::String>::SharedPtr pub_;
  rclcpp::Publisher<std_msgs::msg::Float32>::SharedPtr
      steer_ms_pub_, esc_ms_pub_, steer_us_pub_, esc_us_pub_, steer_rad_pub_,
      speed_pub_, steer_norm_pub_, esc_norm_pub_;
  rclcpp::TimerBase::SharedPtr timer_;
};
int main(int argc,char**argv){
 rclcpp::init(argc,argv);rclcpp::spin(std::make_shared<Actuator>());rclcpp::shutdown();return 0;
}
